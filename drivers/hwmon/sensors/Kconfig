## drivers/hwmon/sensors/Kconfig
```kconfig
menu "ZTE Sensors Support"

config ZTE_SENSORS
    bool "ZTE_SENSORS"
	default n
	depends on I2C && SYSFS
    help
      support for zte sensors.

config SENSORS_TMD2771
	bool "Taos TMD2771 digital ALS and proximity sensor"
	default n
	depends on ZTE_SENSORS
	help
	  If you say yes here you get support for the Taos TMD2771
	  digital ALS and proximity sensor.

	  This driver can also be built as a module.  If so, the module
	  will be called tmd2771.

config TMD2771_SUSPEND_POWEROFF
	bool "Taos TMD2771 suspend power off"
	default n
	depends on SENSORS_TMD2771 && ZTE_SENSORS
	help
	  If you say yes here, the device power wil be shutdown when system
	  enter suspend.

config SENSORS_AK8962
	bool "AK8962 compass support"
	default n
	depends on ZTE_SENSORS
	help
	  If you say yes here you get support for Asahi Kasei's
	  orientation sensor AK8962.

config SENSORS_L3G4200D
	bool "L3G4200D gyroscope support"
	default n
	depends on ZTE_SENSORS
	help
	  If you say yes here you get support for STMicroelectronics
	  L3G4200D groscope sensor.

config SENSORS_LSM330D_G
	bool "LSM330D gyroscope support"
	default n
	depends on ZTE_SENSORS
	help
	  If you say yes here you get support for STMicroelectronics
	  LSM330D groscope sensor.

source "drivers/hwmon/sensors/accel/Kconfig"

endmenu
```

## drivers/hwmon/sensors/accel/Kconfig
```kconfig
#
# Accelemeter driver
#
menuconfig ACCEL_SENSORS
	bool "Auto check accelemeter driver"
	default n
	depends on ZTE_SENSORS
	---help---
	  Say Y here to get to see options for device drivers from various
	  different categories. This option alone does not add any kernel code.

	  If you say N, all options in this submenu will be skipped and disabled.

source "drivers/hwmon/sensors/accel/chip/Kconfig"
```

## drivers/hwmon/sensors/accel/chip/Kconfig
```kconfig
#
# Accelemeter chips for auto check
#

config ACCEL_SENSORS_LIS3DH
	bool "LIS3DH Accelemeter support"
	default n
	depends on ACCEL_SENSORS
	help
	  If you say yes here you get support for STMicroelectronics
	  LIS3DH accelemeter sensor.

config SENSORS_LIS3DH_AXISMAP
	int "LIS3DH Accelemeter axis map"
	default 0
	depends on ACCEL_SENSORS && ACCEL_SENSORS_LIS3DH
	help
	  Set the relation between chip axis and board axis

config ACCEL_SENSORS_LSM330D_A
	bool "LSM330D Accelemeter support"
	default n
	depends on ACCEL_SENSORS
	help
	  If you say yes here you get support for STMicroelectronics
	  LSM330D accelemeter sensor.

config SENSORS_LSM330D_A_AXISMAP
	int "LSM330D Accelemeter axis map"
	default 0
	depends on ACCEL_SENSORS && ACCEL_SENSORS_LSM330D_A
	help
	  Set the relation between chip axis and board axis

config ACCEL_SENSORS_MMA845X
	bool "MMA845X accelemeter support"
	default n
	depends on ACCEL_SENSORS
	help
	  If you say yes here you get support for Freescale
	  MMA845X accelemeter sensor.
	  
config SENSORS_MMA845X_AXISMAP
	int "MMA845X Accelemeter axis map"
	default 0
	depends on ACCEL_SENSORS && ACCEL_SENSORS_MMA845X
	help
	  Set the relation between chip axis and board axis

config ACCEL_SENSORS_KXTF9
	bool "KXTF9 accelemeter support"
	default n
	depends on ACCEL_SENSORS
	help
	  If you say yes here you get support for KIONIX
	  KXTIK-1004 accelemeter sensor.

config SENSORS_KXTF9_AXISMAP
	int "KXTF9 Accelemeter axis map"
	default 0
	depends on ACCEL_SENSORS && ACCEL_SENSORS_KXTF9
	help
	  Set the relation between chip axis and board axis
```

## drivers/sii8240/Kconfig
```kconfig
#
# HDMI to MHL  device configuration
#

menu "MHL sii8240 support"

config SII8240_MHL_TX
	tristate "MHL_Sii8240"
	default n
	help
	  If you say yes here you get support for the MHL_Sii8240 transimitter.

	  This driver can also be built as a module.  If so, the module
	  will be called MHL_Sii8240.

endmenu
```

## sound/soc/codecs/max9809X/Kconfig
```kconfig
config SND_SOC_MAX9809X
	tristate "MAX9809X Codec"
	
config DEVICE_MAX98095	
    bool "MAX98095 codec"
	depends on SND_SOC_MAX9809X
	default y
    help
        Support for max98095 codec	

config DEVICE_MAX98096	
    bool "MAX98096 codec"
	depends on SND_SOC_MAX9809X
	default n
    help
        Support for max98096 codec	
```
